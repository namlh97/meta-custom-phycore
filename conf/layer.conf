## conf/layer.conf
```bitbake
# We have a conf and classes directory, add to BBPATH
BBPATH .= ":${LAYERDIR}"

# We have recipes-* directories, add to BBFILES
BBFILES += "${LAYERDIR}/recipes-*/*/*.bb \
            ${LAYERDIR}/recipes-*/*/*.bbappend"

BBFILE_COLLECTIONS += "meta-custom-phycore"
BBFILE_PATTERN_meta-custom-phycore = "^${LAYERDIR}/"
BBFILE_PRIORITY_meta-custom-phycore = "6"

LAYERDEPENDS_meta-custom-phycore = "core"
LAYERSERIES_COMPAT_meta-custom-phycore = "warrior zeus nanbield"
```

## conf/machine/imx8x-phycore-kit.conf
```bitbake
#@TYPE: Machine
#@NAME: PHYTEC i.MX8XP phyCORE Kit
#@SOC: i.MX8XP
#@DESCRIPTION: Machine configuration for the phyCORE-i.MX8X Kit

require conf/machine/include/imx8x-phycore-som.inc
require conf/machine/include/imx8x-phycore-kit-dtbs.inc
require conf/machine/include/arm/armv8a/tune-cortexa35.inc

UBOOT_MAKE_TARGET = "u-boot.bin"
UBOOT_SUFFIX = "bin"
UBOOT_CONFIG ??= "sd"
UBOOT_CONFIG[sd] = "pcm065_defconfig,sdcard"

# Don't include kernels in standard images
RDEPENDS_${KERNEL_PACKAGE_NAME}-base = ""
RDEPENDS_${KERNEL_PACKAGE_NAME}-image = ""

LOADADDR = ""

# Set ATF platform name
ATF_PLATFORM = "imx8qx"

# Disable the serial console due to auto-serial-console
SERIAL_CONSOLES = "115200;ttyAMA0"

# we do not want to have getty running on tty1 as we run
# auto-serial-console there
USE_VT = "0"

BOOT_SPACE = "65536"
IMAGE_BOOTLOADER = "imx-boot"
IMX_BOOT_SEEK = "32"

# Set imx-mkimage boot target
IMX_BOOT_SOC_TARGET = "iMX8QX"
IMXBOOT_TARGETS = \
    "${@bb.utils.contains('UBOOT_CONFIG',   'sd', 'flash', \
        bb.utils.contains('UBOOT_CONFIG', 'fspi', 'flash_flexspi', \
                                                  'UNKNOWN', d), d)}"

# Carrier Board WiFi/BT (Laird Sterling-LWB) support
LWB_COMPLIANCE = "fcc"
# This is used in the name of the NVRAM file when using the package
# kernel-module-laird-backports
BRCM_BOARDTYPE = "phytec,imx8qxp-pcm-942"

IMAGE_INSTALL:append = " \
			 wireless-regdb-static \
			 wpa-supplicant \
			 "

# Install development tools
IMAGE_INSTALL:append = " packagegroup-core-buildessential \
			 cmake python3 python3-pip git apt dpkg"

MACHINEOVERRIDES .= ":imx8x-phycore-kit"
```

## conf/machine/include/imx8x-phycore-som.inc
```bitbake
# Common settings for PHYTEC phyCORE-i.MX8X

MACHINEOVERRIDES =. "mx8:mx8x:mx8qxp:mx8qxpc0:"

require conf/machine/include/imx-base.inc
require conf/machine/include/arm/arch-arm64.inc

#PREFERRED_PROVIDER_u-boot_${MACHINE} = "u-boot-imx"
#PREFERRED_PROVIDER_virtual/bootloader_${MACHINE} = "u-boot-imx"
#PREFERRED_PROVIDER_virtual/kernel_${MACHINE} = "linux-imx"
```
